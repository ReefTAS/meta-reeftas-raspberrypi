## conf/layer.conf
```bitbake
BBPATH .= ":${LAYERDIR}"

# We have a recipes directory, add to BBFILES
BBFILES += "${LAYERDIR}/recipes*/*/*.bb ${LAYERDIR}/recipes*/*/*.bbappend ${LAYERDIR}/images/*.bb"

BBFILE_COLLECTIONS += "meta-reeftas-raspberrypi"
BBFILE_PATTERN_meta-reeftas-raspberrypi = "^${LAYERDIR}/"
BBFILE_PRIORITY_meta-reeftas-raspberryi = "10"
```

## conf/local.conf.sample
```bitbake
# Local configuration for meta-rpi images
# Yocto Project 2.1 Poky distribution [krogoth] branch
# This is a sysvinit system

LICENSE_FLAGS_WHITELIST = "commercial"

DISTRO_FEATURES = "ext2 systemd usbhost ${DISTRO_FEATURES_LIBC}"
DISTRO_FEATURES += "reeftas-uboot"

DISTRO_FEATURES_BACKFILL_CONSIDERED += "pulseaudio"

PREFERRED_PROVIDER_jpeg = "libjpeg-turbo"
PREFERRED_PROVIDER_jpeg-native = "libjpeg-turbo-native"

PREFERRED_PROVIDER_udev = "eudev"
VIRTUAL-RUNTIME_init_manager = "systemd"
DISTRO_FEATURES_BACKFILL_CONSIDERED = "sysvinit"

MACHINE_FEATURES_remove = "apm"

IMAGE_FSTYPES = "wic wic.bmap tar.xz"
IMAGE_BOOT_FILES_append = "boot.scr u-boot.bin;${SDIMG_KERNELIMAGE} uImage"
IMAGE_INSTALL_append = " kernel-image kernel-devicetree"

PREFERRED_VERSION_linux-raspberrypi = "4.9.%"
KERNEL_IMAGETYPE = "uImage"

WKS_FILE  = "sdimage-reeftas-raspberrypi.wks"

MACHINE = "raspberrypi3"

DISTRO = "poky"

PACKAGE_CLASSES = "package_ipk"

DISABLE_OVERSCAN = "1"
DISPMANX_OFFLINE = "1"
ENABLE_UART = "1"

EXTRA_IMAGE_FEATURES = "debug-tweaks"

USER_CLASSES = "image-mklibs image-prelink"
PATCHRESOLVE = "noop"
RM_OLD_IMAGE = "1"
CONF_VERSION = "1"
PREFERRED_VERSION_dtc-natvie = "1.4.4"
```

## wic/sdimage-reeftas-raspberrypi.wks
```
# short-description: Create Raspberry Pi SD card image
# long-description: Creates a partitioned SD card image for use with
# Raspberry Pi. Boot files are located in the first vfat partition.

part /boot --source bootimg-partition --ondisk mmcblk --fstype=vfat --label boot --active --align 4096 --size 20
include reeftas.wks.inc
```
